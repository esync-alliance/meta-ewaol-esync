## conf/layer.conf
```bitbake
# We have a conf and classes directory, add to BBPATH
BBPATH .= ":${LAYERDIR}"

# We have recipes-* directories, add to BBFILES
BBFILES += "${LAYERDIR}/recipes-*/*/*.bb \
            ${LAYERDIR}/recipes-*/*/*/*.bb \
            ${LAYERDIR}/packagegroups/*.bb \
            ${LAYERDIR}/recipes-*/*/*.bbappend"

BBFILE_COLLECTIONS += "ewaol-esync"
BBFILE_PATTERN_ewaol-esync = "^${LAYERDIR}/"
BBFILE_PRIORITY_ewaol-esync = "5"

# This should only be incremented on significant changes that will
# cause compatibility issues with other layers
LAYERVERSION_ewaol-esync = "2"
LAYERSERIES_COMPAT_ewaol-esync = "honister kirkstone"
```
